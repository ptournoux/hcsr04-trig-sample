## sample.yaml
```
common:
  tags: sensor
  depends_on: sensor
  harness: console
  harness_config:
    type: one_line
    regex:
      - "<inf> Distance: ([0-9].[0-9]+) m"
sample:
  description: Demonstration of single pin HC_SR04 ultrasonic sensor driver module
  name: HCSR04TRIG sample
```

## prj.conf
```kconfig
CONFIG_GPIO=y
CONFIG_SENSOR=y
CONFIG_HCSR04TRIG=y
```

## boards/nucleo_l073rz.overlay
```dts
&gpioa {
    hcsr04trig {
        compatible = "hcsr04trig";
        label = "HCSR04TRIG_0";
        trigger-gpios = <&gpioa 5 GPIO_ACTIVE_HIGH>;  // TRIG: PA5 (D13)
        status = "okay";
    };
};
```

## boards/nucleo_wl55jc.overlay
```dts
&gpioa {
    us0: hc-sr04 {
        compatible = "elecfreaks,hc-sr04";
        label = "HC-SR04_0";
        trig-gpios = <&gpioa 5 GPIO_ACTIVE_HIGH>;  // TRIG: PA5 (D13)
        echo-gpios = <&gpioa 0 GPIO_ACTIVE_HIGH>;  // ECHO: PA0 (A0)
        status = "okay";
    };
};
```

## src/main.c
```c
#include <zephyr/kernel.h>
#include <zephyr/drivers/gpio.h>
#include <zephyr/drivers/sensor.h>
#include <string.h>
#define LOG_LEVEL CONFIG_LOG_DEFAULT_LEVEL
#include <zephyr/logging/log.h>


const struct device *const dev = DEVICE_DT_GET_ONE(hcsr04trig);


int main(void)
{

    if (dev == NULL) {
        printk("Error: HCSR04TRIG device not found\n");
        return -1;
    }

    if (!device_is_ready(dev)) {
		printk("\nError: Device \"%s\" is not ready; "
		       "check the driver initialization logs for errors.\n",
		       dev->name);
		return -90;
	}

    printk("HCSR04TRIG device found and ready\n");

    while (1) {

        struct sensor_value distance;
        int ret = sensor_sample_fetch(dev);
        if (ret < 0) {
            printk("Error: sensor_sample_fetch failed: %d\n", ret);
            continue;
        }

        ret = sensor_channel_get(dev, SENSOR_CHAN_DISTANCE, &distance);
        if (ret < 0) {
            printk("Error: sensor_channel_get failed: %d\n", ret);
            continue;
        }

        printk("Distance: %d.%d m\n", distance.val1,distance.val2);

	    k_sleep(K_MSEC(1000)); // Sample every 1 second
    }

}
```
